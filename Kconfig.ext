## Kconfig.ext
```kconfig
# SPDX-License-Identifier: GPL-2.0
# This file is intentionally empty. It's used as a placeholder for when
# KCONFIG_EXT_PREFIX isn't defined.
source "$(KCONFIG_EXT_PREFIX)kernel/oplus_cpu/Kconfig"
```
